//  @   ./drivers/mmc/host/sdhci-esdhc-imx.c:301:	{ .compatible = "fsl,imx8qm-usdhc", .data = &usdhc_imx8qm_data, },
usdhc1: usdhc@5b010000 {
    compatible = "fsl,imx8qm-usdhc", "fsl,imx6sl-usdhc";
    interrupt-parent = <&gic>;
    interrupts = <GIC_SPI 232 IRQ_TYPE_LEVEL_HIGH>;
    reg = <0x0 0x5b010000 0x0 0x10000>;
    clocks = <&clk IMX8QXP_SDHC0_IPG_CLK>,
        <&clk IMX8QXP_SDHC0_CLK>,
        <&clk IMX8QXP_CLK_DUMMY>;
    clock-names = "ipg", "per", "ahb";
    assigned-clocks = <&clk IMX8QXP_SDHC0_SEL>, <&clk IMX8QXP_SDHC0_DIV>;
    assigned-clock-parents = <&clk IMX8QXP_CONN_PLL1_CLK>;
    assigned-clock-rates = <0>, <400000000>;
    power-domains = <&pd_conn_sdch0>;
    fsl,tuning-start-tap = <20>;
    fsl,tuning-step= <2>;
    status = "disabled";
};


usdhc2: usdhc@5b020000 {
    compatible = "fsl,imx8qm-usdhc", "fsl,imx6sl-usdhc";
    interrupt-parent = <&gic>;
    interrupts = <GIC_SPI 233 IRQ_TYPE_LEVEL_HIGH>;
    reg = <0x0 0x5b020000 0x0 0x10000>;
    clocks = <&clk IMX8QXP_SDHC1_IPG_CLK>,
        <&clk IMX8QXP_SDHC1_CLK>,
        <&clk IMX8QXP_CLK_DUMMY>;
    clock-names = "ipg", "per", "ahb";
    assigned-clocks = <&clk IMX8QXP_SDHC1_SEL>, <&clk IMX8QXP_SDHC1_DIV>;
    assigned-clock-parents = <&clk IMX8QXP_CONN_PLL1_CLK>;
    assigned-clock-rates = <0>, <200000000>;
    power-domains = <&pd_conn_sdch1>;
    fsl,tuning-start-tap = <20>;
    fsl,tuning-step= <2>;
    status = "disabled";
};

//  @   arch/arm64/boot/dts/freescale/fsl-imx8qxp-autolink-tsu.dtsi
&usdhc1 {
	pinctrl-names = "default", "state_100mhz", "state_200mhz";
	pinctrl-0 = <&pinctrl_usdhc1>;
	pinctrl-1 = <&pinctrl_usdhc1_100mhz>;
	pinctrl-2 = <&pinctrl_usdhc1_200mhz>;
	bus-width = <8>;
	non-removable;
	status = "okay";
};

&usdhc2 {
	pinctrl-names = "default";
	pinctrl-0 = <&pinctrl_usdhc2>;
	bus-width = <4>;
	vmmc-supply = <&reg_3v3_wifi>;
	non-removable;
	status = "okay";
};